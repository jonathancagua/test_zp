## boards/1_sparkfun_stm32f405/Kconfig.board
```kconfig
# Adafruit Feather STM32F405 Express board configuration

# Copyright (c) 2020 Lucian Copeland for Adafruit Industries
# SPDX-License-Identifier: Apache-2.0

config BOARD_SPARKFUN_STM32F405
	bool "SparkFun MicroMod STM32F405"
	depends on SOC_STM32F405XG
```

## boards/1_sparkfun_stm32f405/Kconfig.defconfig
```kconfig
# Adafruit Feather STM32F405 Express board configuration

# Copyright (c) 2020 Lucian Copeland for Adafruit Industries.
# SPDX-License-Identifier: Apache-2.0

if BOARD_SPARKFUN_STM32F405

config BOARD
	default "sparkfun_stm32f405"

endif # BOARD_SPARKFUN_STM32F405
```
